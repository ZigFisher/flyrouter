## package/nrpe/Config.in
```kconfig
config BR2_PACKAGE_NRPE
	prompt "nrpe.............................. Daemon to execute Nagios check commands on remote hosts"
	tristate
	default m if CONFIG_DEVEL
	help
	  Daemon to execute Nagios check commands on remote hosts

	  http://www.nagios.org/download
```

## package/nsca/Config.in
```kconfig
#menu "nsca............................. NSCA - Nagios Service Check Acceptor"

config BR2_COMPILE_NSCA
	tristate
	default y
	depends BR2_PACKAGE_NSCA || BR2_PACKAGE_SEND-NSCA
	
config BR2_PACKAGE_NSCA
	prompt "nsca.......................... NSCA daemon - Nagios Service Check Acceptor"
	tristate
	default m if CONFIG_DEVEL
	select BR2_COMPILE_NSCA
	help
	  NSCA daemon - Nagios Service Check Acceptor

config BR2_PACKAGE_SEND-NSCA
	prompt "send-nsca..................... NSCA client - Nagios Service Check Acceptor"
	tristate
	default m if CONFIG_DEVEL
	select BR2_COMPILE_SEND-NSCA
	help
	  NSCA client - Nagios Service Check Acceptor

#endmenu
```

## package/nttcp/Config.in
```kconfig
config BR2_PACKAGE_NTTCP
	prompt "nttcp............................. A TCP connection performance tester"
	tristate
	default m if CONFIG_DEVEL
	help
	  A small utility to test TCP connection performance
	  
	  http://linux.die.net/man/1/nttcp
	  http://sd.wareonearth.com/~phil/net/ttcp/
	  
```

## package/nut/Config.in
```kconfig
menu "nut............................... Network UPS Tools provide monitoring of UPS hardware"

config BR2_COMPILE_NUT
        tristate
        default m if CONFIG_DEVEL
        depends BR2_PACKAGE_NUT-DRIVERS || BR2_PACKAGE_NUT-SERVER || BR2_PACKAGE_NUT-CLIENTS

config BR2_PACKAGE_NUT-DRIVERS
        prompt "nut-drivers....................... NUT-DRIVERS"
        tristate
        default m if CONFIG_DEVEL
	select BR2_COMPILE_NUT
        help
          nut-drivers - programs talk directly to your UPS hardware

config BR2_PACKAGE_NUT-SERVER
        prompt "nut-server........................ NUT-SERVER"
        tristate
        default m if CONFIG_DEVEL
	select BR2_COMPILE_NUT
        help
          nut-server - upsd serves data from the drivers to the network

config BR2_PACKAGE_NUT-CLIENTS
        prompt "nut-clients....................... NUT-CLIENTS"
        tristate
        default m if CONFIG_DEVEL
	select BR2_COMPILE_NUT
        help
          nut-clients - talk to upsd and do things with the status data

endmenu
```

## package/nvram/Config.in
```kconfig
config BR2_PACKAGE_NVRAM
	prompt "nvram............................. Broadcom config utility"
	tristate
	default y 
	depends BR2_LINUX_2_4_BRCM5354
	help
	  control utility for broadcom's 'nvram' config area
```

## package/obexftp/Config.in
```kconfig
menu "obexftp........................... the file transfer feature for clients and servers"

config BR2_COMPILE_OBEXFTP
        tristate
	default m if CONFIG_DEVEL
	select BR2_PACKAGE_OPENOBEX
	select BR2_PACKAGE_LIBUSB
	depends BR2_PACKAGE_OBEXFTP-LIB || BR2_PACKAGE_OBEXFTP-CLIENT || BR2_PACKAGE_OBEXFTP-SERVER

config BR2_PACKAGE_OBEXFTP-LIB
	prompt "obexftp-lib....................... OBEXFTP lib"
	tristate
	default m if CONFIG_DEVEL
	select BR2_COMPILE_OBEXFTP
	help
	 ObexFTP implements the Object Exchange file transfer feature for clients and servers

config BR2_PACKAGE_OBEXFTP-CLIENT
	prompt "obexftp-client.................... OBEXFTP client"
	tristate
	default m if CONFIG_DEVEL
	select BR2_COMPILE_OBEXFTP
	select BR2_PACKAGE_OBEXFTP-LIB
	help
	 ObexFTP implements the Object Exchange file transfer feature for clients and servers

config BR2_PACKAGE_OBEXFTP-SERVER
	prompt "obexftp-server.................... OBEXFTP server"
	tristate
	default m if CONFIG_DEVEL
	select BR2_COMPILE_OBEXFTP
	select BR2_PACKAGE_OBEXFTP-LIB
	help
	 ObexFTP implements the Object Exchange file transfer feature for clients and servers

endmenu
																                                                
```

## package/opendchub/Config.in
```kconfig
config BR2_PACKAGE_OPENDCHUB
	prompt "opendchub......................... Open DC hub is software for the Direct Connect network"
	tristate
	default m if CONFIG_DEVEL
	help
	  Open DC hub is a Unix/Linux version of the hub software for the Direct Connect network. 
	  
	  http://opendchub.sourceforge.net/
```

## package/openobex/Config.in
```kconfig
config BR2_PACKAGE_OPENOBEX
	prompt "openobex.......................... OBEX "
	tristate
	default m if CONFIG_DEVEL
	help
	  OBEX is a session protocol and can best be described as a binary HTTP protocol
```

## package/owfs/Config.in
```kconfig
menu "owfs.............................. 1-Wire file system"

config BR2_PACKAGE_OWFS
	prompt "owfs.............................. 1-Wire file system"
	tristate
	select BR2_PACKAGE_LIBPTHREAD
	default m if CONFIG_DEVEL
	help
	    OWFS is an easy way to use the powerful 1-wire system of Dallas/Maxim. 

	    http://owfs.org/

config BR2_COMPILE_OWFS_WITH_USB
	prompt "Enable owfs with USB support"
	bool
	default n
	depends BR2_PACKAGE_LIBUSB

config BR2_COMPILE_OWFS_WITH_PARPORT
	prompt "Enable owfs with Parallel port (IEEE 1284) support"
	bool
	default n
	
config BR2_COMPILE_OWFS_WITH_I2C
	prompt "Enable i2c (DS2482-x00) support"
	bool
	default y

config BR2_COMPILE_OWFS_WITH_SWIG
	prompt "Enable swig support (need swig installed)"
	bool
	default n

config BR2_COMPILE_OWFS_WITH_OWPHP
	prompt "Compile PHP support if possible"
	bool
	default n

config BR2_COMPILE_OWFS_WITH_OWPERL
	prompt "Compile Perl support if possible"
	bool
	default n

config BR2_COMPILE_OWFS_WITH_OWTCL
	prompt "Compile TCL support if possible"
	bool
	default n

config BR2_COMPILE_OWFS_WITH_OWPYTHON
	prompt "Compile Python support if possible"
	bool
	default n

endmenu
```

## package/pjproject/Config.in
```kconfig
config BR2_PACKAGE_PJPROJECT
	prompt "pjproject......................... PJSUA is a command line SIP user agent (UA)."
	tristate
	default m if CONFIG_DEVEL
	#select BR2_PACKAGE_LIB..
	help
	  PJSUA is a command line SIP user agent (UA) written with PJSIP Open source SIP stack.
	  
	  http://www.pjsip.org/
```

## package/remserial/Config.in
```kconfig
config BR2_PACKAGE_REMSERIAL
	prompt "remserial......................... Bridge between a TCP/IP network port and a Linux device such as a serial port"
	tristate
	default m if CONFIG_DEVEL
	help
	  The remserial program acts as a communications bridge between a TCP/IP network port and a Linux device such as a serial port.
	  
	  http://lpccomp.bc.ca/remserial/
```

## package/rtlflash/Config.in
```kconfig
config BR2_PACKAGE_RTLFLASH
	prompt "rtlflash.......................... flash save/restore/clear for RTL865xB SOC"
	tristate
	default m if CONFIG_DEVEL
	help
	  rtlflash - flash save/restore/clear for RTL865xB SOC
```

## package/scmxx/Config.in
```kconfig
config BR2_PACKAGE_SCMXX
	prompt "scmxx............................. Communicate with Siemens mobile phones"
	tristate
	default n
	help
	  Cool software for use with Siemens mobile phones with many features:
	  * detect which phone is present and handle it properly
	  * send, get, and remove logos (bitmap files)
	  * send, get, and remove ring tones (midi files)
	  * send, get, and remove vCalendars (only some phones)
	  * send, get, and remove vCards (only some phones)
	  * send and get phonebook entries (with Unicode if supported by the phone)
	  * send and receive SMS through phone (optionally with Unicode and multipart support)
	  * store and get received SMS

	  http://www.hendrik-sattler.de/scmxx/
	  http://www.hamradio.crimea.ua/downloads/software/linux/archive/
```

## package/setbaud/Config.in
```kconfig
config BR2_PACKAGE_SETBAUD
	prompt "setbaud........................... Simple serial port configuration utility"
	tristate
	default m if CONFIG_DEVEL
	help
	  setbaud is simple serial port configuration utility
	  
	  http://schimmelnetz.de/projekte/eddi/files/set_ttyS1_2400_8N1.c (setbaud.c)
```

## package/sethdlc/Config.in
```kconfig
config BR2_PACKAGE_SIGRAND_SETHDLC
	prompt "sethdlc ................. HDLC drivers configuration utility"
	tristate
	default y if CONFIG_DEVEL
```

## package/sgauth/Config.in
```kconfig
config BR2_PACKAGE_SGAUTH
	prompt "sgauth............................ Stargazer Internet authorization system"
	tristate
	default m if CONFIG_DEVEL
	select BR2_PACKAGE_UCLIBCXX
	select BR2_PACKAGE_LIBPTHREAD
	help
	  Stargazer Internet authorization system.
	  
	  http://drool-linux.pisem.net/
```

## package/shc/Config.in
```kconfig
config BR2_PACKAGE_SHC
	prompt "shc............................... Generic shell script compiler"
	tristate
	default m if CONFIG_DEVEL
	help
	  Generic shell script compiler
	
	  http://www.datsi.fi.upm.es/~frosal/
	  Example: shc -v -T -f demo.sh
```

## package/sigrand-adm5120sw/Config.in
```kconfig
config BR2_PACKAGE_SIGRAND_ADM5120SW
	prompt "adm5120sw ................. ADM5120 switch driver"
	tristate
	default y if CONFIG_DEVEL
	depends on BR2_LINUX_2_6_SIGRAND5120

config BR2_PACKAGE_SIGRAND_ADM5120SW_LINKCTRL
	prompt "adm5120sw-link-control..... ADM5120 switch link control"
	bool
	default n
	depends on BR2_PACKAGE_SIGRAND_ADM5120SW
	depends on BR2_LINUX_2_6_SIGRAND5120
	
```

## package/sigrand-doc/Config.in
```kconfig
config BR2_PACKAGE_SIGRAND_DOC
	prompt "Sigrand context help.............. HTML ang image files for help sysytem"
	tristate
	default n if CONFIG_DEVEL
	help
		Package contains Sigrand user manual, integrated in web interface
```

## package/sigrand-mr16g/Config.in
```kconfig
config BR2_PACKAGE_SIGRAND_MR16G
	prompt "mr16g_hdlc ................. Sigrand MR16G E1 adapter driver"
	tristate
	default y if CONFIG_DEVEL
	depends on BR2_LINUX_2_6_SIGRAND5120
```

## package/sigrand-mr16h/Config.in
```kconfig
config BR2_PACKAGE_SIGRAND_MR16H
	prompt "sg16lan ................. Sigrand MR16H SHDSL module driver"
	tristate
	default y if CONFIG_DEVEL
	depends on BR2_LINUX_2_6_SIGRAND5120

config BR2_PACKAGE_SIGRAND_MR16H_LINKMAP
	prompt "sg16lan-linkmap ......... Sigrand MR16H dsl <--> eth mapping"
	bool
	default n
	depends on BR2_LINUX_2_6_SIGRAND5120
	depends on (BR2_PACKAGE_SIGRAND_MR16H && BR2_PACKAGE_SIGRAND_ADM5120SW_LINKCTRL)
```

## package/sigrand-mr17h/Config.in
```kconfig
config BR2_PACKAGE_SIGRAND_MR17H
	prompt "mr17h ................. Sigrand MR17H SHDSL module driver"
	tristate
	default y if CONFIG_DEVEL
	depends on BR2_LINUX_2_6_SIGRAND5120

config BR2_PACKAGE_SIGRAND_MR17H_DEBUG
	prompt "mr17h_dbg ................. Sigrand MR17H SHDSL module Debug"
	bool
	default n
	depends on BR2_LINUX_2_6_SIGRAND5120
	depends on BR2_PACKAGE_SIGRAND_MR17H
```

## package/sobexsrv/Config.in
```kconfig
config BR2_PACKAGE_SOBEXSRV
	prompt "sobexsrv.......................... OBEX..."
	tristate
	default n if CONFIG_DEVEL
	select BR2_PACKAGE_LIBICONV
	help
	 OK
```

## package/spcaview/Config.in
```kconfig
config BR2_PACKAGE_SPCAVIEW
	prompt "spcaview.......................... This set of tools are provide to test WebCam under Linux"
	tristate
	default m if CONFIG_DEVEL
	select BR2_PACKAGE_LIBPTHREAD
	help
	  This set of tools are provide to test WebCam under Linux.
	  
	  http://mxhaard.free.fr/
	  
```

## package/sredird/Config.in
```kconfig
config BR2_PACKAGE_SREDIRD
	prompt "sredird........................... serial port internet server."
	tristate
	default m if CONFIG_DEVEL
	help
	  This program when run through inetd will use the RFC 2217
	  extensions to TELNET to implement serial commands over the
	  TCP connection and interface to a specified serial port.
	  
	  http://www.ibiblio.org/pub/Linux/system/serial/
	  http://www.hamradio.crimea.ua/downloads/linux/source/
```
