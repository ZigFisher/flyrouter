## package/alsa-lib/Config.in
```kconfig
config BR2_PACKAGE_ALSA-LIB
	prompt "alsa-lib.......................... ALSA (Advanced Linux Sound Architecture) library"
	tristate
	default m if CONFIG_DEVEL
	help
	  ALSA (Advanced Linux Sound Architecture) library
	  This is the library package for alsa, needed by some userspace programs.
	  You must have enabled the ALSA support in the kernel.
	  
	  http://www.alsa-project.org/
```

## package/alsa-utils/Config.in
```kconfig
menu "alsa-utils........................ ALSA (Advanced Linux Sound Architecture) utilities"

config BR2_COMPILE_ALSA-UTILS
	tristate
	default n
	depends BR2_PACKAGE_APLAY || BR2_PACKAGE_AMIXER || BR2_PACKAGE_ALSAMIXER
	select BR2_PACKAGE_ALSA-LIB
	
config BR2_PACKAGE_APLAY
	prompt "aplay............................. aplay"
	tristate
	default n
	select BR2_COMPILE_ALSA-UTILS
	help
	  ALSA (Advanced Linux Sound Architecture) utilities
	  
	  http://www.alsa-project.org/

config BR2_PACKAGE_AMIXER
	prompt "amixer............................ amixer"
	tristate
	default n
	select BR2_COMPILE_ALSA-UTILS
	help
	  ALSA (Advanced Linux Sound Architecture) utilities
	  
	  http://www.alsa-project.org/

config BR2_PACKAGE_ALSAMIXER
	prompt "alsamixer......................... alsamixer"
	tristate
	default n
	select BR2_COMPILE_ALSA-UTILS
	help
	  ALSA (Advanced Linux Sound Architecture) utilities
	  
	  http://www.alsa-project.org/

endmenu
```

## package/aprsdigi/Config.in
```kconfig
menu "aprsdigi.......................... APRSDIGI (aprsdigi, aprsmon)"
                                                                                                                                              
config BR2_COMPILE_APRSDIGI
        tristate
        default m if CONFIG_DEVEL
	depends BR2_PACKAGE_APRSDIGI || BR2_PACKAGE_APRSMON
        select BR2_PACKAGE_LIBAX25

config BR2_PACKAGE_APRSDIGI
        prompt "aprsdigi.......................... APRSDIGI"
        tristate
        default m if CONFIG_DEVEL
        select BR2_COMPILE_APRSDIGI
        help
          aprsdigi - APRS(tm) digipeater

config BR2_PACKAGE_APRSMON
        prompt "aprsmon........................... APRSMON"
        tristate
        default m if CONFIG_DEVEL
        select BR2_COMPILE_APRSDIGI
        help
          aprsmon - monitor APRS AX.25 traffic
                                                                                                                                              
endmenu
```

## package/arlix-utils/Config.in
```kconfig
menu "arlix-utils....................... ARLIX-UTILS"
                                                                                                                              
config BR2_COMPILE_ARLIX-UTILS
        tristate
        default m
        depends BR2_PACKAGE_CALIBRATE || BR2_PACKAGE_JINF || BR2_PACKAGE_QTH || BR2_PACKAGE_REMOTE || BR2_PACKAGE_YAPP || BR2_PACKAGE_UI-CLUSTER || BR2_PACKAGE_X-BOT
        select BR2_PACKAGE_LIBAX25

config BR2_PACKAGE_AX25-CALIBRATE
        prompt "calibrate......................... CALIBRATE"
        tristate
        default m if CONFIG_DEVEL
        select BR2_COMPILE_CALIBRATE
        help
          Calibrate - is ...

config BR2_PACKAGE_JINF
        prompt "jinf.............................. JINF"
        tristate
        default m if CONFIG_DEVEL
        select BR2_COMPILE_JINF
        help
          Jinf - is ...

config BR2_PACKAGE_QTH
        prompt "qth............................... QTH"
        tristate
        default m if CONFIG_DEVEL
        select BR2_COMPILE_QTH
        help
          Qth - is ...

config BR2_PACKAGE_REMOTE
        prompt "remote............................ REMOTE"
        tristate
        default m if CONFIG_DEVEL
        select BR2_COMPILE_REMOTE
        help
          Remote - is ...

config BR2_PACKAGE_YAPP
        prompt "yapp.............................. YAPP"
        tristate
        default m if CONFIG_DEVEL
        select BR2_COMPILE_YAPP
        help
          Yapp - is ...

config BR2_PACKAGE_UI-CLUSTER
        prompt "ui-cluster........................ UI-CLUSTER"
        tristate
        default m if CONFIG_DEVEL
        select BR2_COMPILE_UI-CLUSTER
        help
          Ui-cluster - is ...

config BR2_PACKAGE_X-BOT
        prompt "x-bot............................. X-BOT"
        tristate
        default m if CONFIG_DEVEL
        select BR2_COMPILE_X-BOT
        help
          X-bot - is ...
                                                                                                                                              
endmenu
```

## package/avrdude/Config.in
```kconfig
config BR2_PACKAGE_AVRDUDE
	prompt "avrdude........................... Atmel AVR microcontrollers programmer"
	tristate
	default m if CONFIG_DEVEL
	select BR2_PACKAGE_LIBREADLINE
	select BR2_PACKAGE_LIBNCURSES
	select BR2_PACKAGE_LIBUSB
	help

	  Avrdude is a program for downloading code and data to Atmel AVR microcontrollers
	  
	  http://ftp.de.debian.org/debian/pool/main/a/avrdude/
```

## package/ax25-apps/Config.in
```kconfig
menu "ax25-apps......................... AX25-APPS (call, listen)"

config BR2_COMPILE_AX25-APPS
        tristate
        default m if CONFIG_DEVEL
        depends BR2_PACKAGE_CALL || BR2_PACKAGE_LISTEN
        select BR2_PACKAGE_LIBAX25
        select BR2_PACKAGE_LIBREADLINE

config BR2_PACKAGE_CALL
        prompt "call.............................. CALL"
        tristate
        default m if CONFIG_DEVEL
	select BR2_COMPILE_AX25-APPS
        help
          call - make an AX.25, NET/ROM or Rose connection

config BR2_PACKAGE_LISTEN
        prompt "listen............................ LISTEN"
        tristate
        default m if CONFIG_DEVEL
	select BR2_COMPILE_AX25-APPS
        help
          listen - monitor AX.25 traffic

endmenu
```

## package/ax25-tools/Config.in
```kconfig
menu "ax25-tools........................ AX25-TOOLS (ax25-call, beacon, rxecho, kissattach, kissparms)"
                                                                                                                                              
config BR2_COMPILE_AX25-TOOLS
        tristate
        default m if CONFIG_DEVEL
	depends BR2_PACKAGE_AX25-CALL || BR2_PACKAGE_BEACON || BR2_PACKAGE_RXECHO || BR2_PACKAGE_KISSATTACH || BR2_PACKAGE_KISSPARMS
        select BR2_PACKAGE_LIBAX25

config BR2_PACKAGE_AX25-CALL
        prompt "ax25-call......................... AX25-CALL"
        tristate
        default m if CONFIG_DEVEL
        select BR2_COMPILE_AX25-TOOLS
        help
          ax25_call - make an AX.25 connection

config BR2_PACKAGE_BEACON
        prompt "beacon............................ BEACON"
        tristate
        default m if CONFIG_DEVEL
        select BR2_COMPILE_AX25-TOOLS
        help
          beacon - transmit periodic messages on an AX.25 port

config BR2_PACKAGE_RXECHO
        prompt "rxecho............................ RXECHO"
        tristate
        default m if CONFIG_DEVEL
        select BR2_COMPILE_AX25-TOOLS
        help
	  rxecho - route AX.25 packets between ports transparently

config BR2_PACKAGE_KISSATTACH
        prompt "kissattach........................ KISSATTACH"
        tristate
        default m if CONFIG_DEVEL
        select BR2_COMPILE_AX25-TOOLS
        help
          kissattach - attach a KISS or 6PACK interface

config BR2_PACKAGE_KISSPARMS
        prompt "kissparms......................... KISSPARMS"
        tristate
        default m if CONFIG_DEVEL
        select BR2_COMPILE_AX25-TOOLS
        help
          kissparms - configure KISS TNCs
                                                                                                                                              
endmenu
```

## package/axgetput/Config.in
```kconfig
config BR2_PACKAGE_AXGETPUT
	prompt "axgetput.......................... This shell utility for up/downloading files via your ax25 unix login"
	tristate
	default m if CONFIG_DEVEL
	help
	  This shell utility is for up/downloading files via your ax25 unix login
	  session which is managed by axspawn.
	  You need a //BIN compatible axspawn, which has the functionality of making
	  the stream 8bit compatible (normally the EOL-conversion <LF> <-> <CR> prevents this).
	                                                                                                                                                  
	  http://x-berg.in-berlin.de/cgi-bin/viewcvs.cgi/ampr/axgetput/                                                                               
	  http://www.hamradio.crimea.ua/downloads/linux/source/
```

## package/axip/Config.in
```kconfig
config BR2_PACKAGE_AXIP
	prompt "axip.............................. A daemon to encapsulate AX25 frames in UDP datagrams"
	tristate
	default m if CONFIG_DEVEL
	select BR2_PACKAGE_LIBAX25
	help
	  A daemon to encapsulate AX25 frames in UDP datagrams.
	  
	  ftp://ham2.cc.fer.hr/pub/users/9a4gl/openwrt/
	  http://www.hamradio.crimea.ua/downloads/software/linux/archive/
```

## package/bcmflash/Config.in
```kconfig
config BR2_PACKAGE_BCMFLASH
	prompt "bcmflash.......................... flash save/restore/clear for BCM6345 SOC"
	tristate
	default m if CONFIG_DEVEL
	help
	  bcmflash - flash save/restore/clear for BCM6345 SoC
```

## package/bluejacker/Config.in
```kconfig
config BR2_PACKAGE_BLUEJACKER
	prompt "bluejacker........................ Bluejacker script for BluePoint system"
	tristate
	default m if CONFIG_DEVEL
	help
	  Bluejacker script for BluePoint system. 
	  
	  http://bluez.org
```

## package/bluespam/Config.in
```kconfig
config BR2_PACKAGE_BLUESPAM
	prompt "bluespam.......................... Bluespam.."
	tristate
	default m if CONFIG_DEVEL
	select BR2_PACKAGE_BLUEZ-LIBS
	help
	  Bluespam....
	  
	  http://www.josos.org/index/040-softwares/bluetooth/
```

## package/bluez-utils/Config.in
```kconfig
menu "bluez-utils....................... Bluetooth utilities"

config BR2_COMPILE_BLUEZ_UTILS
	tristate
	default m if CONFIG_DEVEL
	select BR2_PACKAGE_GLIB1
	select BR2_PACKAGE_BLUEZ_LIBS
	depends BR2_PACKAGE_HCICONFIG || BR2_PACKAGE_HCID || BR2_PACKAGE_HCITOOL || BR2_PACKAGE_L2PING || BR2_PACKAGE_RFCOMM || BR2_PACKAGE_SDPD || BR2_PACKAGE_PAND || BR2_PACKAGE_SDPTOOL
	help
	  Bluez utils. 
	  
	  http://bluez.org
	  
	  Depends: libpthread, bluez-libs


config BR2_PACKAGE_HCICONFIG
	prompt   "hciconfig....................... configure Bluetooth devices"
	tristate
	default m if CONFIG_DEVEL
	select BR2_COMPILE_BLUEZ_UTILS

config BR2_PACKAGE_HCID
	prompt   "hcid............................ the Bluetooth Host Controller Interface Daemon"
	tristate
	default m if CONFIG_DEVEL
	select BR2_COMPILE_BLUEZ_UTILS

config BR2_PACKAGE_HCITOOL
	prompt   "hcitool......................... configure Bluetooth connections"
	tristate
	default m if CONFIG_DEVEL
	select BR2_COMPILE_BLUEZ_UTILS

config BR2_PACKAGE_L2PING
	prompt   "l2ping.......................... send L2CAP echo request and receive answer"
	tristate
	default m if CONFIG_DEVEL
	select BR2_COMPILE_BLUEZ_UTILS

config BR2_PACKAGE_RFCOMM
	prompt   "rfcomm.......................... ?"
	tristate
	default m if CONFIG_DEVEL
	select BR2_COMPILE_BLUEZ_UTILS

config BR2_PACKAGE_PAND
	prompt   "pand............................ ?"
	tristate
	default m if CONFIG_DEVEL
	select BR2_COMPILE_BLUEZ_UTILS

config BR2_PACKAGE_SDPD
	prompt   "sdpd............................ ?"
	tristate
	default m if CONFIG_DEVEL
	select BR2_COMPILE_BLUEZ_UTILS

config BR2_PACKAGE_SDPTOOL
	prompt   "sdptool......................... ?"
	tristate
	default m if CONFIG_DEVEL
	select BR2_COMPILE_BLUEZ_UTILS

endmenu
```

## package/cln/Config.in
```kconfig
config BR2_PACKAGE_CLN
	prompt "cln............................... Client for Remote Authorization Daemon"
	tristate
	default m if CONFIG_DEVEL
	help
	  Client for Remote Authorization Daemon
	  
	  http://???
```

## package/conversd/Config.in
```kconfig
config BR2_PACKAGE_CONVERSD
	prompt "conversd.......................... daemon conversd-saupp"
	tristate
	default m if CONFIG_DEVEL
	help
	  Convers daemon conversd-saupp
	  
	  http://x-berg.in-berlin.de/cgi-bin/viewcvs.cgi/ampr/conversd-saupp/
```

## package/cpu/Config.in
```kconfig
config BR2_PACKAGE_CPU
	tristate "cpu............................... Reports CPU utilization"
	default m if CONFIG_DEVEL
	help
	 reports CPU utilization as a percentage of used time slices in a period.
```

## package/dash/Config.in
```kconfig
config BR2_PACKAGE_DASH
	prompt "dash.............................. dash is a POSIX compliant shell that is much smaller than bash."
	tristate
	default y
	help
		dash is a POSIX compliant shell that is much smaller than "bash". We take advantage of that by making it the shell on the installation root floppy, where space is at a premium.
		It can be usefully installed as /bin/sh (because it executes scripts somewhat faster than "bash"), or as the default shell either of root or of a second user with a userid of 0 (because it depends on fewer libraries, and is therefore less likely to be affected by an upgrade problem or a disk failure). It is also useful for checking that a script uses only POSIX syntax.

		http://en.wikipedia.org/wiki/Debian_Almquist_shell

config BR2_COMPILE_DASH_WITH_HDB
	prompt "Enable hdb builtin"
	bool
	default n
	depends BR2_PACKAGE_DASH

config BR2_COMPILE_DASH_WITH_KDB
	prompt "Enable kdb builtin"
	bool
	default n
	depends BR2_PACKAGE_DASH
```

## package/dbhub/Config.in
```kconfig
config BR2_PACKAGE_DBHUB
	prompt "dbhub..............................A Direct Connect hub for Linux/Unix"
	tristate
	default n
	help
	  A Direct Connect hub for Linux/Unix
	  
	  http://dbhub.org
```

## package/dbus/Config.in
```kconfig
config BR2_PACKAGE_DBUS
	prompt "dbus.............................. D-BUS is a simple IPC framework based on messages"
	tristate
	default m if CONFIG_DEVEL
	help
	      D-BUS is a simple IPC framework based on messages.

	      http://www.freedesktop.org/Software/dbus
```

## package/dnrd/Config.in
```kconfig
config BR2_PACKAGE_DNRD
	prompt "dnrd.............................. Domain Name Relay Daemon"
	tristate
	default m if CONFIG_DEVEL
	select BR2_PACKAGE_LIBPTHREAD
	help
	  Domain Name Relay Daemon.
	  
	  http://dnrd.sourceforge.net/
```

## package/empty/Config.in
```kconfig
config BR2_PACKAGE_EMPTY
	prompt "empty............................. empty - run applications under pseudo-terminal (PTY) sessions"
	tristate
	default m if CONFIG_DEVEL
	help
	  empty - run applications under pseudo-terminal (PTY) sessions.
	  Replace TCL/Expect with a simple tool and use your favorite shell (sh, bash, csh, tcsh, ksh, zsh, etc).
	  
	  http://sourceforge.net/project/empty
	  http://www.hamradio.crimea.ua/downloads/linux/source/
```

## package/etherdump/Config.in
```kconfig
config BR2_PACKAGE_ETHERDUMP
	prompt "etherdump......................... etherdump is an extremely small packet sniffer"
	tristate
	default m if CONFIG_DEVEL
	help
	  etherdump is an extremely small packet sniffer (alternative of tcpdump and utcpdump)

	  http://freshmeat.net/projects/etherdump/
```

## package/flyflash/Config.in
```kconfig
config BR2_PACKAGE_FLYFLASH
	prompt "flyflash.......................... flash save/restore/clear for FlyRouter devices"
	tristate
	default m if CONFIG_DEVEL
	help
	  flyflash - flash save/restore/clear for FlyRouter devices
```

## package/flypinger/Config.in
```kconfig
config BR2_PACKAGE_FLYPINGER
	prompt "flypinger......................... Pinger script for FlyPinger system"
	tristate
	default m if CONFIG_DEVEL
	help
	  Pinger script for FlyPinger system.
	  
	  http://flyrouter.net
```

## package/flyscript/Config.in
```kconfig
config BR2_PACKAGE_FLYSCRIPT
	prompt "flyscript......................... More network script's for FlyRouter"
	tristate
	default m if CONFIG_DEVEL
	help
	  More network script's for FlyRouter.
	  
	  http://flyrouter.net
```
