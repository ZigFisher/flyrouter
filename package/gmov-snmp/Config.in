## package/gmov-snmp/Config.in
```kconfig
config BR2_PACKAGE_GMOV-SNMP
	prompt "gmov-snmp......................... A lightweight SNMP daemon"
	tristate
	default m if CONFIG_DEVEL
	help
	  A lightweight SNMP daemon.
	  
	  http://gmov-snmp.sourceforge.net/
```

## package/gpioctl/Config.in
```kconfig
config BR2_PACKAGE_GPIOCTL
	prompt "gpioctl.......................... Tool for controlling gpio pins"
	tristate
	default m if CONFIG_DEVEL
	help
	  Tool for controlling gpio pins
```

## package/hotplug/Config.in
```kconfig
config BR2_PACKAGE_HOTPLUG
        prompt "hotplug........................... Hotplug lets you plug in new devices and use them immediately"
        tristate
        default m if CONFIG_DEVEL
        help
		Hotplug lets you plug in new devices and use them immediately
```

## package/i2c-tools/Config.in
```kconfig
config BR2_PACKAGE_I2C-TOOLS
	prompt "i2c-tools......................... I2C tools for Linux"
	tristate
	default m if CONFIG_DEVEL
	help
	  I2C tools for Linux.
	  
	  http://dl.lm-sensors.org/i2c-tools/releases/
```

## package/ifenslave/Config.in
```kconfig
config BR2_PACKAGE_IFENSLAVE
	prompt "ifenslave......................... Configure network interfaces for parallel routing"
	tristate
	default y
	help
	   This program controls the Linux implementation of running multiple
		network interfaces in parallel.
```

## package/ipsec-tools/Config.in
```kconfig
config BR2_PACKAGE_IPSEC_TOOLS
	prompt "ipsec-tools....................... IPsec management tools"
	tristate
	depends BR2_LINUX_2_6 || BR2_LINUX_2_6_ADM5120 || BR2_LINUX_2_6_SIGRAND5120
	select BR2_PACKAGE_LIBOPENSSL
	default m if CONFIG_DEVEL
	help
	  IPsec management tools
	  
	  http://ipsec-tools.sourceforge.net/
```

## package/iputils/Config.in
```kconfig
menu "iputils........................... A collection of utilites for controlling TCP/IP networking"

config BR2_COMPILE_IPUTILS
	tristate
	default n
	depends BR2_PACKAGE_IPUTILS_PING || BR2_PACKAGE_IPUTILS_ARPING

config BR2_PACKAGE_PING
	prompt   "ping............................ Tools to test the reachability of network hosts"
	tristate
	default m if CONFIG_DEVEL
	select BR2_COMPILE_IPUTILS

config BR2_PACKAGE_ARPING
	prompt   "arping.......................... Tools to send ICMP echo requests to an ARP address"
	tristate
	default m if CONFIG_DEVEL
	select BR2_COMPILE_IPUTILS

endmenu
```

## package/irda-utils/Config.in
```kconfig
config BR2_PACKAGE_IRDA_UTILS
	prompt "irda-utils........................ IRDA utilities"
	tristate
	default m if CONFIG_DEVEL
	select BR2_PACKAGE_IRDA_UTILS
	help
	  IRDA utils. 
	  
	  http://irda.sf.net
	  
	  Depends: 
```

## package/libabz/Config.in
```kconfig
config BR2_PACKAGE_LIBABZ
	prompt "libabz............................ Miscellaneous useful routines"
	tristate
	default m if CONFIG_DEVEL
	help
		Miscellaneous useful routines

		http://oasis.frogfoot.net/code/libabz/
```

## package/libax25/Config.in
```kconfig
config BR2_PACKAGE_LIBAX25
	prompt "libax25........................... AX.25 library (Amateur Radio)"
	tristate
	default m if CONFIG_DEVEL
	help
	  AX.25 library (Amateur Radio).
	  
	  http://ax25.sourceforge.net/
	  http://www.hamradio.crimea.ua/downloads/software/linux/archive/
```

## package/libber/Config.in
```kconfig
config BR2_PACKAGE_LIBBER
	prompt "libber............................ A Basic Encoding Rules (ITU X.690) implementation"
	tristate
	default m if CONFIG_DEVEL
	help
		A Basic Encoding Rules (ITU X.690) implementation

		http://oasis.frogfoot.net/code/libber/
```

## package/libdebug/Config.in
```kconfig
config BR2_PACKAGE_LIBDEBUG
	prompt "libdebug.......................... Memory leak detection system and logging library"
	tristate
	default m if CONFIG_DEVEL
	help
		Memory leak detection system and logging library

		http://oasis.frogfoot.net/code/libdebug/
```

## package/libstdc++/Config.in
```kconfig
config BR2_PACKAGE_LIBSTDCXX
	prompt "libstdc++......................... C++ library"
	tristate
	default m if CONFIG_DEVEL
	help
	  A standard C++ library
```

## package/libtiff/Config.in
```kconfig
config BR2_PACKAGE_LIBTIFF
	prompt "libtiff............................ libtiff"
	tristate
	default m if CONFIG_DEVEL
	help
          LIBTIFF -
	  	  
	  http://www.remotesensing.org/libtiff/
```

## package/lincardemu/Config.in
```kconfig
config BR2_PACKAGE_LINCARDEMU
	prompt "lincardemu........................ LINCARDEMU"
	tristate
	default m if CONFIG_DEVEL
	help
	  LINCARDEMU - 
	  
	  http://streamboard.gmc.to
```

## package/linsv/Config.in
```kconfig
config BR2_PACKAGE_LINSV
	prompt "linsv............................. Linux SuperVozelj node"
	tristate
	default m if CONFIG_DEVEL
	select BR2_PACKAGE_LIBAX25
	help
	  Linux SuperVozelj node.
	  
	  ftp://ham2.cc.fer.hr/pub/users/9a4gl/openwrt/
	  http://www.hamradio.crimea.ua/downloads/software/linux/archive/
```

## package/mc/Config.in
```kconfig
config BR2_PACKAGE_MC
	prompt "mc................................ The GNU Midnight Commander, a powerful filemanager"
	tristate
	default m if CONFIG_DEVEL
	select BR2_PACKAGE_LIBNCURSES
	select BR2_PACKAGE_GLIB1
	help
	  GNU Midnight Commander is a text-mode full-screen file manager. 
	  It uses a two panel interface and a subshell for command execution. 
	  It includes an internal editor with syntax highlighting and an 
	  internal viewer with support for binary files. Also included is 
	  Virtual Filesystem (VFS), that allows files on remote systems 
	  (e.g. FTP, SSH, SMB servers) and files inside archives to be 
	  manipulated like real files.
	  
	  http://www.ibiblio.org/mc/
```

## package/microdc2/Config.in
```kconfig
config BR2_PACKAGE_MICRODC2
	prompt "microdc2.......................... Is a command-line based Direct Connect client"
	tristate
	default m if CONFIG_DEVEL
	help
	  Is a command-line based Direct Connect client
	  
	  http://corsair626.no-ip.org/microdc/
```

## package/mini_snmpd/Config.in
```kconfig
config BR2_PACKAGE_MINI_SNMPD
	prompt "mini-snmpd........................ SNMP server for embedded systems"
	tristate
	default m if CONFIG_DEVEL
	help
	  SNMP server for embedded systems
	  
	  http://members.aon.at/linuxfreak/linux/mini_snmpd.html
```

## package/module-init-tools/Config.in
```kconfig
config BR2_PACKAGE_MODULEINITTOOLS
	prompt "module-init-tools................. module-init-tools"
	tristate
	default m if CONFIG_DEVEL
	help
	  module-init-tools
	  
```

## package/mpcs-cs/Config.in
```kconfig
config BR2_PACKAGE_MPCS-CS
	prompt "mpcs-cs........................... MPCS-CS"
	tristate
	default m if CONFIG_DEVEL
	select BR2_PACKAGE_LIBPTHREAD
	help
	  MPCS-CS - card-server
	  
	  http://streamboard.gmc.to
	  http://www.hamradio.crimea.ua/downloads/software/linux/archive/
```

## package/mpcs-tiny/Config.in
```kconfig
config BR2_PACKAGE_MPCS-TINY
	prompt "mpcs-tiny......................... MPCS-TINY"
	tristate
	default m if CONFIG_DEVEL
	help
	  MPCS-TINY - 
	  
	  http://streamboard.gmc.to
	  http://www.hamradio.crimea.ua/downloads/software/linux/archive/
```

## package/mpcs/Config.in
```kconfig
config BR2_PACKAGE_MPCS
	prompt "mpcs.............................. MPCS"
	tristate
	default m if CONFIG_DEVEL
	help
	  MPCS - 
	  
	  http://streamboard.gmc.to
	  http://www.hamradio.crimea.ua/downloads/software/linux/archive/
```

## package/nail/Config.in
```kconfig
config BR2_PACKAGE_NAIL
	prompt "nail.............................. Text-mode mail client"
	tristate
	default m if CONFIG_DEVEL
	help
		Nail is derived from Berkeley Mail and is intended provide the functionality of the                                           
		POSIX mailx command with additional support for MIME, IMAP, POP3, SMTP, and S/MIME.
```

## package/nmeap/Config.in
```kconfig
config BR2_PACKAGE_NMEAP
	prompt "nmeap............................. GPS navigation"
	tristate
	default m if CONFIG_DEVEL
	help
	  This navigation
	                                                                                                                                                  
	  http://www.hamradio.crimea.ua/downloads/linux/source/
```
