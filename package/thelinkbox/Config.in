## package/thelinkbox/Config.in
```kconfig
config BR2_PACKAGE_THELINKBOX
	prompt "thelinkbox......................... AmateurRadio VoIP system for *NIX"
	tristate
	default m if CONFIG_DEVEL
	help
	  AmateurRadio VoIP system for *NIX
	  
	  http://sourceforge.net/apps/mediawiki/cqinet/index.php?title=Linkbox-url
	  http://groups.yahoo.com/group/thelinkbox/files/
```

## package/tinysnmp/Config.in
```kconfig
menu "tinysnmp.......................... A lightweight SNMPv1 implementation (agent, tools, modules)"

config BR2_COMPILE_TINYSNMP
	tristate
	default n
	depends BR2_PACKAGE_TINYSNMP-TOOLS || BR2_PACKAGE_TINYSNMP-AGENT || BR2_PACKAGE_TINYSNMP-MODULE-INTERFACES || BR2_PACKAGE_TINYSNMP-MODULE-RESOURCES

config BR2_PACKAGE_TINYSNMP-TOOLS
	prompt   "tinysnmp-tools.............................. TinySNMP Utilities"
	tristate
	default m if CONFIG_DEVEL
	select BR2_COMPILE_TINYSNMP
	select BR2_PACKAGE_LIBABZ
	select BR2_PACKAGE_LIBBER
	select BR2_PACKAGE_LIBDEBUG

config BR2_PACKAGE_TINYSNMP-AGENT
	prompt   "tinysnmp-agent.............................. A lightweight SNMPv1 implementation"
	tristate
	default m if CONFIG_DEVEL
	select BR2_COMPILE_TINYSNMP
	select BR2_PACKAGE_LIBABZ
	select BR2_PACKAGE_LIBBER
	select BR2_PACKAGE_LIBDEBUG
	select BR2_PACKAGE_LIBEVENT

config BR2_PACKAGE_TINYSNMP-MODULE-INTERFACES
	prompt   "tinysnmp-module-interfaces.................. Interfaces MIB module for TinySNMP"
	tristate
	default m if CONFIG_DEVEL
	select BR2_COMPILE_TINYSNMP

config BR2_PACKAGE_TINYSNMP-MODULE-RESOURCES
	prompt   "tinysnmp-module-resources................... Frogfoot Networks Resources MIB plugin for TinySNMP"
	tristate
	default m if CONFIG_DEVEL
	select BR2_COMPILE_TINYSNMP
endmenu
```

## package/uronode/Config.in
```kconfig
config BR2_PACKAGE_URONODE
	prompt "uronode........................... Amateur Packet Radio node (AX25,NetRom,Rose,FlexNet)"
	tristate
	default n
	select BR2_PACKAGE_LIBAX25
	help
	  UROnode is based on AWZ|LinuxNode by Tomi Manninen OH2BNS and FlexNode
	  by Roy PE1RJA. It was born initially for the aripisa.ampr.org system
	  by Stefano Noferi IZ5AWZ of ARI Ham Radio Association of Pisa (ITALY)..
	  
	  ftp://ftp.n1uro.net/pub/ax25/
	  http://www.hamradio.crimea.ua/downloads/software/linux/archive/
```

## package/usb-modeswitch/Config.in
```kconfig
config BR2_PACKAGE_USB-MODESWITCH
	prompt "usb-modeswitch.................... A small mode switching tool for controlling multiple device USB gear"
	tristate
	default m if CONFIG_DEVEL
	select BR2_PACKAGE_LIBUSB
	help
	  A small mode switching tool for controlling multiple device USB gear
	  
	  http://www.draisberghof.de/usb_modeswitch
```

## package/ussp-push/Config.in
```kconfig
config BR2_PACKAGE_USSP-PUSH
	prompt "ussp-push......................... object pusher, using the BlueZ BlueTooth stack"
	tristate
	default m if CONFIG_DEVEL
	select BR2_PACKAGE_LIBUSB
	help
	  ussp-push is a OBEX object pusher for Linux, using the BlueZ BlueTooth stack.
	  
	  http://www.xmailserver.org/ussp-push.html
	  http://www.hamradio.crimea.ua/downloads/software/linux/archive/
```

## package/utcpdump/Config.in
```kconfig
config BR2_PACKAGE_UTCPDUMP
	prompt "utcpdump.......................... Network monitoring and data acquisition tool (lite)"
	tristate
	default m if CONFIG_DEVEL
	select BR2_PACKAGE_LIBPCAP
	help
	  A tool for network monitoring and data acquisition.
	  
	  http://ftp.chg.ru/pub/Linux/trinux/boot/utcpdump-0.1.tgz
```

## package/vnstati/Config.in
```kconfig
config BR2_PACKAGE_VNSTATI
	prompt "vnstati........................... PNG image output for network traffic monitor (vnstat)"
	tristate
	default m if CONFIG_DEVEL
	select BR2_PACKAGE_LIBGD
	help
	  vnstati - png image output support for console-based network traffic monitor vnstat

	  http://humdi.net/vnstat/
```

## package/vtun/Config.in
```kconfig
config BR2_PACKAGE_VTUN
	prompt "vtun.............................. VPN tunneling daemon"
	tristate
	default m if CONFIG_DEVEL
	help
	  A VPN tunneling daemon
	  
	  http://vtun.sourceforge.net
```

## package/webadmin/Config.in
```kconfig
config BR2_PACKAGE_WEBADMIN
	prompt "webadmin.......................... FlyRouter WEB administration interface"
	tristate
	default m if CONFIG_DEVEL
	select BR2_PACKAGE_HASERL
	help
	  WEB administration interface for FlyRouter
	  
```

## package/webface/Config.in
```kconfig
config BR2_PACKAGE_WEBFACE
	prompt "webface........................... SigrandWebface"
	tristate
	default m if CONFIG_DEVEL
	select BR2_PACKAGE_HASERL
#	select BR2_PACKAGE_LIGHTTPD
#	select BR2_PACKAGE_LIGHTTPD
#	select BR2_PACKAGE_LIGHTTPD_MOD_AUTH
#	select BR2_COMPILE_MINI_HTTPD
	help
	  webface for sigrand routers and modems BLA BLA BLA
	  
```

## package/xmail/Config.in
```kconfig
config BR2_PACKAGE_XMAIL
	prompt "xmail............................. XMail is mail server featuring an SMTP, POP3 and finger server"
	tristate
	default n if CONFIG_DEVEL
	help
	  XMail is an Internet mail server featuring an SMTP, POP3 and finger server.
	  It's incredibly easy to set up and has lots of features including :
	  multiple domains, virtual users and spam protection.
```

## package/zabbix/Config.in
```kconfig
#menu "zabbix............................. Zabbix monitoring system"

config BR2_COMPILE_ZABBIX
	tristate
	default y
	depends BR2_PACKAGE_ZABBIX-AGENTD || BR2_PACKAGE_ZABBIX-SENDER
	select BR2_PACKAGE_LIBREADLINE
	
config BR2_PACKAGE_ZABBIX-AGENTD
	prompt "zabbix-agentd..................... Zabbix agent daemon"
	tristate
	default m if CONFIG_DEVEL
	select BR2_COMPILE_ZABBIX-AGENTD
	help
	  Zabbix agent daemon

config BR2_PACKAGE_ZABBIX-SENDER
	prompt "zabbix-sender..................... Zabbix sender"
	tristate
	default m if CONFIG_DEVEL
	select BR2_COMPILE_ZABBIX-SENDER
	help
	  Zabbix sender

#endmenu
```

## target/linux/adm5120-2.4/Config.in
```kconfig
choice

	prompt "midge type"
	default MIDGE_TYPE_TMPFS
	depends BR2_LINUX_2_4_ADM5120
	config MIDGE_TYPE_JFFS2
		bool "jffs2"
	config MIDGE_TYPE_TMPFS
		bool "tmpfs"
	config MIDGE_TYPE_USB
		bool "usb (not supported)"

endchoice


config MIDGE_FLASH_SIZE
	hex "Flash size"
	default "0x200000"
	depends BR2_LINUX_2_4_ADM5120
	help
		Flash Size in hex

config MIDGE_BOOT_SIZE
	hex "Size of boot sector"
	default "0x08000"
	depends BR2_LINUX_2_4_ADM5120
	help
		Size of boot sector (default 0x8000)

config MIDGE_KERNEL_START
	hex "Kernel entry point"
	default "0x10000"
	depends BR2_LINUX_2_4_ADM5120
	help
		Start position of kernel (default 0x10000)

config MIDGE_KERNEL_BLOCKS
	int "Size of kernel partition in 64k blocks"
	default 10
	depends BR2_LINUX_2_4_ADM5120  
	help
		Size of kernel partition

config MIDGE_SQUASHFS_BLOCKS
	int "Size of read-only partition in 64k blocks"
	default 10
	depends BR2_LINUX_2_4_ADM5120  
	help
		Size of kernel partition

config BR2_PACKAGE_KMOD_ADM5120_SW
	prompt "kmod-adm5120-sw   ADM5120 Switch Driver"
	tristate
	depends BR2_LINUX_2_4_ADM5120
	default y
	help
	  Switch driver for adm5120 SoC

config BR2_PACKAGE_KMOD_ADM5120_USB
	prompt "kmod-usb-shci     ADM5120 USB Driver"
	tristate
	depends BR2_LINUX_2_4_ADM5120
	default m
	select BR2_PACKAGE_KMOD_USB_CONTROLLER
	help
		USB driver for ADM5120 (works fine USB storage and maybe USB printers)
		USB-Webcams, USB-Serial and similar 'interrupt' devices is not supported

config BR2_PACKAGE_KMOD_ADM5120_I2C
	prompt "kmod-adm5120-i2c  ADM5120 I2C-Support Driver (GPIO)"
	tristate
	depends BR2_LINUX_2_4_ADM5120
	default m
	help
	  Driver for I2C-Bus over GPIO or Switch-LED
	  GPIO has number 0..7
          LED has number 8..22
	  GPIO 0 is reserved for Power-LED
	  GPIO 2 is reserved for Reset-Switch
          GPIO 1 and GPIO 3 are default, see kernel config
          GPIO 3 is used for 4MB-Flash ! 
          Load the driver with parameter scl=8 sda=9 for LED8/9
          Load with "-o i2c-adm5120_x" for multiple i2c-buses 
```

## target/linux/brcm5354-2.4/Config.in
```kconfig
choice
	prompt "skyrouter device target"
	default SKYROUTER_TARGET_WL520GU
	depends BR2_LINUX_2_4_BRCM5354
	config SKYROUTER_TARGET_DIR320
		bool "DIR-320"
	config SKYROUTER_TARGET_WL520GU
		bool "WL-520GU"
	config SKYROUTER_TARGET_WL520GC
		bool "WL-520GC"

endchoice

choice
	prompt "skyrouter protect firmware"
	default SKYROUTER_PROTECT_FLYAVR
	depends BR2_LINUX_2_4_BRCM5354
	config SKYROUTER_PROTECT_FLYAVR
		bool "FlyAVR"
	config SKYROUTER_PROTECT_FLYMAC
		bool "FlyMAC"

endchoice

config BR2_PACKAGE_KMOD_BRCM_WL
	prompt "kmod-brcm-wl...................... Broadcom Wireless Network Driver"
	tristate
	depends BR2_LINUX_2_4_BRCM5354
	default y
	help
	  Proprietary driver for Broadcom Wireless chipsets
```

## target/linux/package/bcmwl/Config.in
```kconfig
config BR2_PACKAGE_KMOD_BCMWL
	prompt "kmod-bcmwl........................ Proprietary WL driver for the BCM43xx chipset"
	tristate
	default y
	depends BR2_LINUX_2_4_BRCM5354
	help
	  Proprietary wireless driver for the BCM43xx chipset
```

## target/linux/package/mmc-adm/Config.in
```kconfig
config BR2_PACKAGE_KMOD_MMC-ADM
        prompt "kmod-mmc-adm...................... Kernel SD/MMC support driver for ADM5120 CPU"
        tristate
	default m if CONFIG_DEVEL
	default n
        help
          Kernel SD/MMC support driver for ADM5120 CPU
	  
	  http://kiel.kool.dk/
```

## target/linux/package/mmc-ng/Config.in
```kconfig
config BR2_PACKAGE_KMOD_MMC-NG
        prompt "kmod-mmc-ng....................... SD/MMC support driver, 850/450 KB/s for W/R"
        tristate
	default m if CONFIG_DEVEL
	default n
        help
          Kernel support for SD/MMC card, now 850KB/s for WRITE and 450KB/s for READ
	  
	  http://programmingstuff.free.fr/files/openwrt/whiterussian/mmc/src/
```

## target/linux/package/mmc/Config.in
```kconfig
config BR2_PACKAGE_KMOD_MMC
        prompt "kmod-mmc.......................... SD/MMC support driver"
        tristate
	default m if CONFIG_DEVEL
	default n
        help
          Kernel support for SD/MMC card
	  
	  http://kiel.kool.dk/
```

## target/linux/package/spca5xx-le/Config.in
```kconfig
config BR2_PACKAGE_KMOD_USB_SPCA5XX_LE
	prompt "kmod-spca5xx-le................... SPCA5XX based USB webcam support (Light Edition)"
	tristate
	default m
	select BR2_PACKAGE_KMOD_VIDEODEV
	select BR2_PACKAGE_KMOD_USB
	help
	  Kernel driver for SPCA5XX based USB webcam support (Light Edition).
	  
	  http://mxhaard.free.fr/
```

## target/linux/package/wlcompat/Config.in
```kconfig
config BR2_PACKAGE_KMOD_WLCOMPAT
	prompt "kmod-wlcompat..................... Wrapper providing Wireless Extensions for Broadcom wl module"
	tristate
	default y
	depends BR2_LINUX_2_4_BRCM5354
	#depends BR2_LINUX_2_4_BRCM5354 || BR2_LINUX_2_4_BRCM6345
	help
	  A wrapper module, that provides Wireless Extension support for the
	  proprietary Broadcom wl module.

config BR2_PACKAGE_KMOD_WLCOMPAT_DEBUG
	prompt "kmod-wlcompat-debug............... Wrapper providing Wireless Extensions for Broadcom wl module (debug)"
	tristate
	default m
	depends BR2_LINUX_2_4_BRCM5354
	#depends BR2_LINUX_2_4_BRCM5354 || BR2_LINUX_2_4_BRCM6345
	help
	  A wrapper module, that provides Wireless Extension support for the
	  proprietary Broadcom wl module. (debug version)
```

## target/linux/rtl8186-2.4/Config.in
```kconfig
choice

	prompt "midge type"
	default MIDGE_TYPE_TMPFS
	depends BR2_LINUX_2_4_RTL8186
	config MIDGE_TYPE_JFFS2
		bool "jffs2"
	config MIDGE_TYPE_TMPFS
		bool "tmpfs"

endchoice


config MIDGE_FLASH_SIZE
	hex "Flash size"
	depends BR2_LINUX_2_4_RTL8186
	default "0x200000"
	help
		Flash Size in hex

config MIDGE_BOOT_SIZE
	hex "Size of boot sector"
	default "0x08000"
	depends BR2_LINUX_2_4_RTL8186
	help
		Size of boot sector (default 0x8000)

config MIDGE_KERNEL_START
	hex "Kernel entry point"
	default "0x10000"
	depends BR2_LINUX_2_4_RTL8186
	help
		Start position of kernel (default 0x10000)

config MIDGE_KERNEL_BLOCKS
	int "Size of kernel partition in 64k blocks"
	default 10
	depends BR2_LINUX_2_4_RTL8186
	help
		Size of kernel partition

config MIDGE_SQUASHFS_BLOCKS
	int "Size of read-only partition in 64k blocks"
	default 10
	depends BR2_LINUX_2_4_RTL8186
	help
		Size of kernel partition
```

## target/linux/rtl865xb-2.4/Config.in
```kconfig
choice

	prompt "beerouter type"
	default BEEROUTER_TYPE_TMPFS
	depends BR2_LINUX_2_4_RTL865xB
	config BEEROUTER_TYPE_JFFS2
		bool "jffs2"
	config BEEROUTER_TYPE_TMPFS
		bool "tmpfs"

endchoice


choice
	prompt "beerouter device target"
	default BEEROUTER_TARGET_EDIMAX
	depends BR2_LINUX_2_4_RTL865xB
	config BEEROUTER_TARGET_EDIMAX
		bool "Edimax"
	config BEEROUTER_TARGET_DLINK
		bool "Dlink"

endchoice

config BEEROUTER_FLASH_SIZE
	hex "Flash size"
	default "0x200000"
	help
		Flash Size in hex

config BEEROUTER_BOOT_SIZE
	hex "Size of boot sector"
	default "0x08000"
	depends BR2_LINUX_2_4_RTL865xB
	help
		Size of boot sector (default 0x8000)

config BEEROUTER_KERNEL_START
	hex "Kernel entry point"
	default "0x20000"
	depends BR2_LINUX_2_4_RTL865xB
	help
		Start position of kernel (default 0x10000)

config BEEROUTER_KERNEL_SIZE
	hex "Size of kernel partition"
	default "0xA0000"
	depends BR2_LINUX_2_4_RTL865xB
	help
		Size of kernel partition

config BEEROUTER_DATAFS_SIZE
	hex "Size of raw data partition"
	default "0x10000"
	depends BR2_LINUX_2_4_RTL865xB
	help
		Size of kernel partition

#config BEEROUTER_SQUASHFS_SIZE
#	int "Size of read-only partition"
#	default XXXXXXXX
#	depends BR2_LINUX_2_4_RTL865xB
#	help
#		Size of kernel partition

config BR2_PACKAGE_KMOD_RTL865XB_USB
	prompt "kmod-usb-ohci-rtl865x     RTL865xB USB Driver"
	tristate
	depends BR2_LINUX_2_4_RTL865xB
	default m
	select BR2_PACKAGE_KMOD_USB_CONTROLLER
	help
	  USB driver for RTL865xB
								
```

## target/linux/sigrand5120-2.6/Config.in
```kconfig
#

choice

        prompt "fs type"
        default SG_FSTYPE_JFFS2
        depends BR2_LINUX_2_6_ADM5120 || BR2_LINUX_2_6_SIGRAND5120
	
	config SG_FSTYPE_JFFS2
    		bool 
		prompt "jffs2"
	config SG_FSTYPE_TMPFS
    		bool 
		prompt "tmpfs"

endchoice
						


config SG_KERNEL_BLOCKS
	int "Size of kernel partition in 64k blocks"
	default 20
	depends BR2_LINUX_2_6_ADM5120 || BR2_LINUX_2_6_SIGRAND5120
	help
		Size of kernel partition

config SG_FS_BLOCKS
	int "Size of read-only partition in 64k blocks"
	default 490
	depends BR2_LINUX_2_6_ADM5120 || BR2_LINUX_2_6_SIGRAND5120
	help
		Size of kernel partition
```
